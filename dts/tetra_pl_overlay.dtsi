// dts/tetra_pl_overlay.dtsi
//
// Owned by Agent A5 (A5-fpga-top-xdc-cleanup).
//
// Full PL device-tree overlay for the tetra-bs FPGA. Aggregates:
//
//   1. The AXI-Lite live-config register window owned by
//      `rtl/infra/tetra_axi_lite_regs.v` (Agent A5) at PS-side base
//      0x4000_0000 (1 KiB span; 12-bit address, 4 KiB-aligned).
//
//   2. The 4× `axi_dma_v7_1` instances from `dts/tetra_axi_dma_overlay.dtsi`
//      (Agent A1) at 0x4040_0000.. 0x4043_FFFF (each 64 KiB).
//
// Both nodes live under `/amba/fpga-axi@0` (the standard Zynq PS-PL bus
// fragment generated by Vivado's `device-tree-xlnx` flow). Apply this
// .dtsi as a single overlay during boot — the daemon `tetra_d` opens
// the register window via UIO (label `tetra_axi_lite_regs`) and the
// DMA channels via `xilinx_axidma.ko` per the dma-name properties
// already in the A1 overlay.
//
// IRQ map (PS GIC, off-by-32 SPI numbering per Zynq TRM, matches A1):
//   29  irq_tma_rx_o    (FPGA→PS signalling-RX completion)
//   30  irq_tma_tx_o    (PS→FPGA signalling-TX completion)
//   31  irq_tmd_rx_o    (FPGA→PS voice-RX completion)
//   32  irq_tmd_tx_o    (PS→FPGA voice-TX completion)
//
// AXI-Lite reg window itself emits no IRQ. Its IRQ_STATUS register
// aggregates PHY/UMAC events into the daemon's poll loop (no GIC line
// dedicated to the reg window in this baseline).

/include/ "tetra_axi_dma_overlay.dtsi"

/ {
    fragment@axi_lite_regs {
        target-path = "/amba/fpga-axi@0";

        __overlay__ {
            #address-cells = <0x1>;
            #size-cells    = <0x1>;

            // -----------------------------------------------------------
            // tetra_axi_lite_regs (rtl/infra/tetra_axi_lite_regs.v)
            //
            // 1 KiB window @ 0x4000_0000. The decoder uses bits [11:0]
            // (4 KiB granularity); 1 KiB suffices because all defined
            // offsets fit in 0x000..0x2FF and 0x300..0xFFF reads return
            // 0 / writes drop.
            //
            // Exposed via UIO so the daemon `tetra_d` mmaps it into
            // userspace; CGI binaries access it indirectly through the
            // daemon's op-dispatcher (config.cgi / debug.cgi).
            // -----------------------------------------------------------
            tetra_axi_lite_regs: tetra-regs@40000000 {
                compatible = "generic-uio", "tetra,axi-lite-regs-v1";
                reg        = <0x40000000 0x1000>;
                clocks     = <&clkc 15>;
                clock-names = "s_axi_aclk";
                /*
                 * UIO label seen as /sys/class/uio/uioN/name — the
                 * daemon scans by this name to find the right device.
                 */
                uio-name   = "tetra-axi-lite-regs";
                /*
                 * No interrupt: the reg window's IRQ_STATUS is polled
                 * by the daemon (it's a 5-bit aggregator for PHY/UMAC
                 * events, sampled in the post-DMA-IRQ handler).
                 */
            };
        };
    };
};
